## main/Kconfig.projbuild
```kconfig
menu "Nucula"

    config NUCULA_SELFTEST_ON_BOOT
        bool "Run crypto/keyset self-tests at every boot"
        default n
        help
            Runs the BDHKE/DLEQ/NUT-13 crypto vectors and the keyset-id
            derivation self-tests during app_main. Costs roughly a second
            of boot time; the same tests are always available at runtime
            via the 'selftest' console command.

        config NUCULA_BOARD_ATOM
            bool "M5Stack Atom Matrix + MFRC522 (NFC reader mode)"
            help
                M5Stack Atom with an MFRC522 on the Grove I2C port.
                NFC role: the wallet is the READER and receives cashu
                tokens from a Type 2 NDEF tag (e.g. an ACR1252 in
                MIFARE Ultralight card-emulation mode, or a real NTAG).

endmenu
```

## sdkconfig.defaults.atom
```kconfig
CONFIG_IDF_TARGET="esp32"
CONFIG_ESP_CONSOLE_UART=y
CONFIG_NUCULA_BOARD_ATOM=y
CONFIG_LOG_MAXIMUM_LEVEL_DEBUG=y
```

## sdkconfig.defaults.m5stick
```kconfig
CONFIG_IDF_TARGET="esp32"
CONFIG_ESP_CONSOLE_UART=y
CONFIG_NUCULA_BOARD_M5STICK=y
CONFIG_LOG_MAXIMUM_LEVEL_DEBUG=y
```
